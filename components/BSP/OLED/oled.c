#include "oled.h"
// ESP-IDF v6.0 新版 I2C 头文件
#include "driver/i2c_master.h"
#include "driver/gpio.h"
#include "freertos/FreeRTOS.h"
#include "freertos/task.h"
#include <string.h>
#include "esp_log.h"

static const char *TAG = "oled";
static uint8_t s_oled_buffer[OLED_WIDTH * (OLED_HEIGHT / 8)];

// I2C 设备句柄
static i2c_master_dev_handle_t oled_dev_handle;

// ==================== SSD1306 命令 ====================
#define SSD1306_DISPLAY_OFF    0xAE
#define SSD1306_DISPLAY_ON     0xAF
#define SSD1306_CHARGE_PUMP    0x8D
#define SSD1306_MEMORY_MODE    0x20
#define SSD1306_SEG_REMAP      0xA1
#define SSD1306_COM_SCAN_DEC   0xC8
#define SSD1306_SET_MUX_RATIO  0xA8
#define SSD1306_SET_COMPINS    0xDA

// ==================== 底层 I2C 发送 (v6.0 API) ====================
static esp_err_t oled_write_bytes(uint8_t *data, size_t len) {
    // 新版直接调用 i2c_master_transmit，不需要组装 cmd link
    return i2c_master_transmit(oled_dev_handle, data, len, -1);
}

static void oled_send_cmd(uint8_t cmd) {
    uint8_t buf[2] = {0x00, cmd}; // 0x00 表示后面跟着的是命令
    oled_write_bytes(buf, 2);
}

// ==================== 复位 ====================

// ==================== I2C 初始化（v6.0 新版） ====================
static esp_err_t i2c_init(void) {
    // 1. 初始化 I2C 总线
    i2c_master_bus_config_t i2c_mst_config = {
        .clk_source = I2C_CLK_SRC_DEFAULT,
        .i2c_port = I2C_NUM_0,
        .scl_io_num = OLED_I2C_SCL_PIN,
        .sda_io_num = OLED_I2C_SDA_PIN,
        .glitch_ignore_cnt = 7,
        .flags.enable_internal_pullup = true,
    };
    i2c_master_bus_handle_t bus_handle;
    ESP_ERROR_CHECK(i2c_new_master_bus(&i2c_mst_config, &bus_handle));

    // 2. 将 OLED 设备添加到 I2C 总线上
    i2c_device_config_t dev_cfg = {
        .dev_addr_length = I2C_ADDR_BIT_LEN_7,
        .device_address = OLED_I2C_ADDR,
        .scl_speed_hz = 100000,
    };
    return i2c_master_bus_add_device(bus_handle, &dev_cfg, &oled_dev_handle);
}

// ==================== OLED 初始化 ====================
esp_err_t oled_init(void) {
    ESP_ERROR_CHECK(i2c_init());

    oled_send_cmd(SSD1306_DISPLAY_OFF);
    oled_send_cmd(SSD1306_SET_MUX_RATIO); oled_send_cmd(0x3F);
    oled_send_cmd(0xD3); oled_send_cmd(0x00);
    oled_send_cmd(0x40);
    oled_send_cmd(SSD1306_CHARGE_PUMP); oled_send_cmd(0x14);
    oled_send_cmd(SSD1306_MEMORY_MODE); oled_send_cmd(0x02);
    oled_send_cmd(SSD1306_SEG_REMAP);
    oled_send_cmd(SSD1306_COM_SCAN_DEC);
    oled_send_cmd(SSD1306_SET_COMPINS); oled_send_cmd(0x12);
    oled_send_cmd(0x81); oled_send_cmd(0xCF);
    oled_send_cmd(0xA4);
    oled_send_cmd(0xA6);
    oled_send_cmd(SSD1306_DISPLAY_ON);

    oled_clear();
    oled_update();
    ESP_LOGI(TAG, "OLED init OK");
    return ESP_OK;
    
}

// ==================== 显存操作 ====================
void oled_clear(void) {
    memset(s_oled_buffer, 0, sizeof(s_oled_buffer));
}

void oled_update(void) {
    for (uint8_t page = 0; page < 8; page++) {
        oled_send_cmd(0xB0 + page);
        oled_send_cmd(0x02); // 列低位地址从2开始
        oled_send_cmd(0x10); // 列高位地址

        uint8_t buf[OLED_WIDTH + 1];
        buf[0] = 0x40; // 0x40 表示后面跟着的是数据
        memcpy(&buf[1], &s_oled_buffer[page * OLED_WIDTH], OLED_WIDTH);
        oled_write_bytes(buf, OLED_WIDTH + 1);
    }
}

void oled_draw_pixel(uint8_t x, uint8_t y) {
    if (x >= OLED_WIDTH || y >= OLED_HEIGHT) return;
    s_oled_buffer[(y / 8) * OLED_WIDTH + x] |= (1 << (y % 8));
}

// ==================== 8x8 ASCII 字库 ====================
// 【正确】6x8点阵：95个ASCII字符，每个字符8行，每行1字节(低6位有效)
static const uint8_t font6x8[95][8] = {
    {0x00,0x00,0x00,0x00,0x00,0x00,0x00,0x00}, // 空格
    {0x00,0x00,0x00,0x2F,0x00,0x00,0x00,0x00}, // !
    {0x00,0x00,0x07,0x00,0x07,0x00,0x00,0x00}, // "
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    {0x00,0x10,0x08,0x08,0x10,0x00,0x00,0x00}  // ~
};
void oled_draw_string(uint8_t x, uint8_t y, const char *str) {
    while (*str) {
        uint8_t c = *str - 32;
        for (int i = 0; i < 8; i++) {
            for (int j = 0; j < 8; j++) {
                if (font6x8[c][i] & (1 << j)) {
                    oled_draw_pixel(x + i, y + j);
                }
            }
        }
        x += 8;
        str++;
    }
}